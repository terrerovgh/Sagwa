## agentshell/edge-firmware/components/sagwa_edge/Kconfig
```kconfig
menu "Sagwa Edge"
config SAGWA_HIGGSFIELD_RIG
    bool "Use the derived articulated Higgsfield rig (experimental)"
    default y
    help
        Uses immutable native layers and the existing local animation FSM.
        Disable to build the recoverable procedural reference rig instead.
        This option does not certify visual quality or hardware performance.
config SAGWA_WAKE_ENABLED
    bool "Enable local WakeNet (requires a matching custom Sagwa model)"
    default n
config SAGWA_MODEL_SHA256
    string "SHA-256 of complete padded custom model partition"
    default ""
    depends on SAGWA_WAKE_ENABLED
config SAGWA_SD_ENABLED
    bool "Mount optional SD for skin descriptors"
    default n
endmenu
```

## agentshell/edge-firmware/sdkconfig.defaults
```kconfig
CONFIG_IDF_TARGET="esp32s3"
CONFIG_ESPTOOLPY_FLASHSIZE_16MB=y
CONFIG_SPIRAM=y
CONFIG_SPIRAM_MODE_QUAD=y
CONFIG_SPIRAM_SPEED_80M=y
CONFIG_SPIRAM_USE_MALLOC=y
CONFIG_ESP_DEFAULT_CPU_FREQ_MHZ_240=y
CONFIG_PARTITION_TABLE_CUSTOM=y
CONFIG_PARTITION_TABLE_CUSTOM_FILENAME="partitions.csv"
CONFIG_PARTITION_TABLE_OFFSET=0x10000
CONFIG_ESP_TASK_WDT_TIMEOUT_S=10
CONFIG_COMPILER_CXX_EXCEPTIONS=n
CONFIG_LV_COLOR_DEPTH_16=y
CONFIG_LV_USE_PERF_MONITOR=n
CONFIG_LV_DEF_REFR_PERIOD=16
CONFIG_MBEDTLS_CERTIFICATE_BUNDLE=y

CONFIG_NVS_ENCRYPTION=y
CONFIG_LV_FONT_MONTSERRAT_16=y
CONFIG_LV_USE_FONT_COMPRESSED=y
CONFIG_NVS_SEC_KEY_PROTECT_NONE=y
CONFIG_BSP_LCD_DRAW_BUF_HEIGHT=240
CONFIG_FREERTOS_GENERATE_RUN_TIME_STATS=y
CONFIG_FREERTOS_USE_TRACE_FACILITY=y
CONFIG_FREERTOS_RUN_TIME_STATS_USING_ESP_TIMER=y

CONFIG_CAMERA_GC0308=y
CONFIG_CAMERA_GC0308_AUTO_DETECT_DVP_INTERFACE_SENSOR=y
CONFIG_CAMERA_GC0308_DVP_RGB565_BE_320X240_20FPS=y
CONFIG_CAMERA_GC0308_DVP_YUV422_YUYV_640X480_16FPS=n
CONFIG_CAMERA_GC0308_DVP_DEFAULT_FMT_RGB565_BE_320X240_20FPS=y
CONFIG_BSP_ERROR_CHECK=n

CONFIG_BOOTLOADER_APP_ROLLBACK_ENABLE=y

# Keep GUI allocations out of the fixed64KiB DRAM pool; preserve DMA/tasks.
CONFIG_LV_USE_CLIB_MALLOC=y
CONFIG_SPIRAM_MALLOC_ALWAYSINTERNAL=2048
CONFIG_SPIRAM_MALLOC_RESERVE_INTERNAL=65536

# Sub10ms deadlines require1ms scheduler ticks; preserve assertions.
CONFIG_FREERTOS_HZ=1000
CONFIG_COMPILER_OPTIMIZATION_PERF=y
```

## agentshell/firmware/sdkconfig.defaults
```kconfig
CONFIG_IDF_TARGET="esp32s3"
CONFIG_ESPTOOLPY_FLASHSIZE_16MB=y
CONFIG_ESPTOOLPY_FLASHMODE_DIO=y
CONFIG_SPIRAM=y
CONFIG_SPIRAM_MODE_QUAD=y
CONFIG_SPIRAM_SPEED_80M=y
CONFIG_SPIRAM_ALLOW_STACK_EXTERNAL_MEMORY=y
CONFIG_ESP_CONSOLE_USB_SERIAL_JTAG=y
CONFIG_PARTITION_TABLE_CUSTOM=y
CONFIG_PARTITION_TABLE_CUSTOM_FILENAME="partitions.csv"
CONFIG_PARTITION_TABLE_OFFSET=0x10000
CONFIG_BOOTLOADER_APP_ROLLBACK_ENABLE=y
CONFIG_MBEDTLS_CERTIFICATE_BUNDLE=y
CONFIG_MBEDTLS_DYNAMIC_BUFFER=y
CONFIG_ESP_HTTP_CLIENT_ENABLE_HTTPS=y
CONFIG_ESP_WEBSOCKET_CLIENT_ENABLE_WSS=y
CONFIG_CAMERA_GC0308_SUPPORT=y
CONFIG_FREERTOS_HZ=1000
CONFIG_ESP_MAIN_TASK_STACK_SIZE=16384
CONFIG_APP_REPRODUCIBLE_BUILD=y
CONFIG_COMPILER_CXX_EXCEPTIONS=y
```
